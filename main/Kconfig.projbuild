## main/Kconfig.projbuild
```kconfig
menu "Latency Test Configuration"
    config BUTTON_HOLD_TIME_MS
        int "Button hold time (ms)"
        default 100
        range 10 1000
        help
            The time in milliseconds for which the button is held down.

    config MAX_BUTTON_DELAY_MS
        int "Maximum button delay (ms)"
        default 100
        range 0 1000
        help
            The maximum delay / shift in milliseconds between when the button is
            released and when the next button press is triggered.

    config BUTTON_PRESS_LEVEL
        int "Level which indicates a button press"
        default 0
        range 0 1
        help
            The level which indicates a button press.

    config BUTTON_GPIO
        int "Button GPIO"
        default 45 if IDF_TARGET_ESP32S3
        help
            The GPIO pin number for the button. Should be one of the free pins
            on the board.

endmenu
```

## sdkconfig.defaults
```kconfig
CONFIG_IDF_TARGET="esp32s3"

CONFIG_FREERTOS_HZ=1000

CONFIG_COMPILER_OPTIMIZATION_PERF=y
# CONFIG_COMPILER_OPTIMIZATION_SIZE=y

# ESP32-specific
#
CONFIG_ESP_DEFAULT_CPU_FREQ_MHZ_240=y
CONFIG_ESP_DEFAULT_CPU_FREQ_MHZ=240

# Common ESP-related
#
CONFIG_ESP_SYSTEM_EVENT_TASK_STACK_SIZE=4096
CONFIG_ESP_MAIN_TASK_STACK_SIZE=8192

# CONFIG_COMPILER_CXX_EXCEPTIONS=y

##  ESPP Logger level
## 0: none
## 1: error
## 2: error, warning
## 3: error, warning, info
## 4: error, warning, info, debug [default]
# CONFIG_ESPP_LOGGER_LOG_LEVEL=0
# CONFIG_ESPP_LOGGER_LOG_LEVEL=1
CONFIG_ESPP_LOGGER_LOG_LEVEL=2
# CONFIG_ESPP_LOGGER_LOG_LEVEL=3
# CONFIG_ESPP_LOGGER_LOG_LEVEL=4
```
